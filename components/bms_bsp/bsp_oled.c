/**
 * @file    bsp_oled.c
 * @brief   SH1106 OLED 显示驱动实现(I2C, 128x64)
 * @author  BMS Team
 * @date    2026-08
 * @note    地址 0x3C, I2C 与 BQ34Z100 共用总线
 *          显存全帧缓冲, refresh() 时整屏刷新
 */
#include "bsp_oled.h"
#include "bms_pinmap.h"
#include "bms_config.h"
#include "driver/i2c.h"
#include "esp_log.h"
#include "freertos/FreeRTOS.h"
#include "freertos/task.h"
#include <string.h>
#include <stdio.h>

static const char *TAG = "BSP_OLED";

#define I2C_PORT            I2C_NUM_0
#define I2C_FREQ_HZ         400000
#define OLED_CMD_MODE       0x00
#define OLED_DAT_MODE       0x40

/* 6x8 ASCII 字库(0x20~0x7E), 共 95 字符 */
static const uint8_t s_font6x8[][6] = {
    {0x00,0x00,0x00,0x00,0x00,0x00},{0x00,0x00,0x5F,0x00,0x00,0x00},{0x00,0x07,0x00,0x07,0x00,0x00},
    {0x14,0x7F,0x14,0x7F,0x14,0x00},{0x24,0x2A,0x7F,0x2A,0x12,0x00},{0x23,0x13,0x08,0x64,0x62,0x00},
    {0x36,0x49,0x55,0x22,0x50,0x00},{0x00,0x05,0x03,0x00,0x00,0x00},{0x00,0x1C,0x22,0x41,0x00,0x00},
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    {0x00,0x41,0x36,0x08,0x00,0x00},{0x02,0x01,0x02,0x04,0x02,0x00},{0x3C,0x26,0x23,0x26,0x3C,0x00},
};

/* 全屏显存: 128x64 / 8 = 1024 字节 */
static uint8_t s_gram[OLED_WIDTH * OLED_HEIGHT / 8];
static uint8_t s_last_gram[OLED_WIDTH * OLED_HEIGHT / 8];  /* 上次刷新快照, 用于变化检测 */
static bool    s_inited = false;

/* ====== 内部函数 ====== */
static bms_err_t oled_write_cmd(uint8_t cmd);
static bms_err_t oled_write_buf(uint8_t mode, const uint8_t *buf, uint16_t len);

static bms_err_t oled_write_buf(uint8_t mode, const uint8_t *buf, uint16_t len)
{
    uint8_t tbuf[130];
    if (len == 0 || (len + 1) > sizeof(tbuf)) {
        return BMS_ERR_PARAM_INVALID;
    }
    tbuf[0] = mode;
    memcpy(&tbuf[1], buf, len);
    esp_err_t ret = i2c_master_write_to_device(I2C_PORT, OLED_I2C_ADDR, tbuf, len + 1, pdMS_TO_TICKS(100));
    return (ret == ESP_OK) ? BMS_OK : BMS_ERR_I2C;
}

static bms_err_t oled_write_cmd(uint8_t cmd)
{
    return oled_write_buf(OLED_CMD_MODE, &cmd, 1);
}

bms_err_t bsp_oled_init(void)
{
    /* 硬件屏蔽: 缺 OLED 时直接返回, 不阻塞系统 */
    if (!HW_ENABLE_OLED) {
        ESP_LOGW(TAG, "OLED 屏蔽 (HW_ENABLE_OLED=0)");
        return BMS_ERR_NOT_INIT;
    }

    /* I2C 总线已由 bsp_bq76952_init 建立(I2C_NUM_0, 400kHz, 2026-08-25 迁移)
     * OLED(0x3C) 与 BQ76952(0x08) 并联同一条总线, 地址不冲突, 无需重复初始化
     * 注意: bsp_oled_init 必须在 bsp_bq76952_init 成功之后调用 */

    /* SH1106 初始化序列 */
    oled_write_cmd(0xAE);                           // 关显示
    oled_write_cmd(0xD5); oled_write_cmd(0x50);     // 时钟分频
    oled_write_cmd(0xA8); oled_write_cmd(0x3F);     // 多路复用比 1/64
    oled_write_cmd(0xD3); oled_write_cmd(0x00);     // 显示偏移
    oled_write_cmd(0x40);                           // 起始行
    oled_write_cmd(0x8D); oled_write_cmd(0x14);     // 电荷泵使能
    oled_write_cmd(0x20); oled_write_cmd(0x02);     // 页寻址模式
    oled_write_cmd(0xA1);                           // 段重定向
    oled_write_cmd(0xC8);                           // COM 扫描方向
    oled_write_cmd(0xDA); oled_write_cmd(0x12);     // COM 引脚配置
    oled_write_cmd(0x81); oled_write_cmd(0xCF);     // 对比度
    oled_write_cmd(0xD9); oled_write_cmd(0xF1);     // 预充电周期
    oled_write_cmd(0xDB); oled_write_cmd(0x40);     // VCOMH 电压
    oled_write_cmd(0xA4);                           // 输出 GDDRAM
    oled_write_cmd(0xA6);                           // 正常显示(非反色)
    oled_write_cmd(0xAF);                           // 开显示

    memset(s_gram, 0, sizeof(s_gram));
    memset(s_last_gram, 0xFF, sizeof(s_last_gram));   /* 初始化为不同值, 强制首次刷新 */
    s_inited = true;
    ESP_LOGI(TAG, "oled init ok (i2c addr=0x%02X)", OLED_I2C_ADDR);
    return BMS_OK;
}

void bsp_oled_clear(void)
{
    if (!s_inited) {
        return;
    }
    memset(s_gram, 0, sizeof(s_gram));
    /* 不在这里 refresh, 由调用方统一 refresh, 避免双重刷新 */
}

void bsp_oled_show_string(uint8_t x, uint8_t y, const char *str)
{
    if (!s_inited || str == NULL || y >= (OLED_HEIGHT / 8)) {
        return;
    }
    uint16_t idx = 0;
    while (str[idx] != '\0' && x < OLED_WIDTH - 6) {
        uint8_t ch = (uint8_t)str[idx];
        if (ch < 0x20 || ch > 0x7E) {
            ch = 0x20;                              // 非法字符显示空格
        }
        const uint8_t *glyph = s_font6x8[ch - 0x20];
        for (uint8_t i = 0; i < 6; i++) {
            if ((x + i) < OLED_WIDTH) {
                s_gram[x + i + y * OLED_WIDTH] = glyph[i];
            }
        }
        x += 6;
        idx++;
    }
}

void bsp_oled_show_float(uint8_t x, uint8_t y, float value, uint8_t digits)
{
    char buf[16];
    snprintf(buf, sizeof(buf), "%.*f", digits, value);
    bsp_oled_show_string(x, y, buf);
}

void bsp_oled_refresh(void)
{
    if (!s_inited) {
        return;
    }
    /* 显存变化检测: 比对当前显存与上次刷新快照, 相同则跳过 I2C 写入
     * 效果: 数据不变时不产生 I2C 通信, 消除总线超时和 GPIO 错误
     * 代价: 额外 1024 字节 RAM 快照 + 一次 memcmp (微秒级) */
    if (memcmp(s_gram, s_last_gram, sizeof(s_gram)) == 0) {
        return;                                     /* 显存未变化, 跳过刷新 */
    }

    /* 批量写: 每页用一次 I2C 事务发送 128 字节数据
     * 优化前: 逐字节写 = 8页 * (3命令 + 128数据) = 1048 次 I2C 事务
     * 优化后: 8 页 * 1 次批量 = 8 次 I2C 事务 (降低 131 倍)
     * 注: SH1106 页寻址模式下, 连续写数据会自动递增列地址 */
    uint8_t buf[130];                               // 1字节模式 + 128字节数据 + 1余量
    bool all_ok = true;                             // 全部 I2C 事务成功标志
    for (uint8_t page = 0; page < (OLED_HEIGHT / 8); page++) {
        /* 设置页地址和列地址(3 条命令) */
        if (oled_write_cmd(0xB0 + page) != BMS_OK) all_ok = false;   // 页地址
        if (oled_write_cmd(0x00)          != BMS_OK) all_ok = false;  // 列低地址
        if (oled_write_cmd(0x10)          != BMS_OK) all_ok = false;  // 列高地址

        /* 批量写 128 字节数据(一次 I2C 事务) */
        buf[0] = OLED_DAT_MODE;                     // 控制字节 = 数据模式
        memcpy(&buf[1], &s_gram[page * OLED_WIDTH], OLED_WIDTH);
        esp_err_t ret = i2c_master_write_to_device(I2C_PORT, OLED_I2C_ADDR,
                                                   buf, OLED_WIDTH + 1, pdMS_TO_TICKS(100));
        if (ret != ESP_OK) {
            all_ok = false;
            ESP_LOGW(TAG, "oled i2c write page %u fail: %s",
                     page, esp_err_to_name(ret));
        }
    }

    /* 关键: 只有全部 I2C 事务成功才更新快照!
     * 旧代码无条件 memcpy, 导致偶发 I2C 失败后快照被错误更新,
     * 之后 memcmp 永远判定"未变化", OLED 显示永久卡死不刷新 */
    if (all_ok) {
        memcpy(s_last_gram, s_gram, sizeof(s_gram));
    }
    /* 失败时保留旧快照, 下一轮 refresh 会自动重试 */
}
